## conf/distro/minimal-desktop.conf
```bitbake
require conf/distro/poky.conf

DISTRO = "minimal-desktop"
DISTRO_NAME = "Minimal Desktop"

EXTRA_IMAGE_FEATURES:remove = " debug-tweaks"
EXTRA_IMAGE_FEATURES:append = " allow-root-login"

ROOT_PASSWD = "\$6\$EcrQCmc4FC8oY8Gu\$MNtBPD8mOktVleWl.J69hFza.KfW2v4VBH7hMzgDATYCQJpBI1YWlFxoBeL.IqwkcSqGYMAojDzFPsh9GJJC4/"

INHERIT += "extrausers"
EXTRA_USERS_PARAMS = "usermod -p '${ROOT_PASSWD}' root;"

DISTRO_FEATURES:append = " wayland pam usrmerge"
PREFERRED_PROVIDER_virtual/mesa = "mesa"
PREFERRED_PROVIDER_virtual/libgl = "mesa"
PREFERRED_PROVIDER_virtual/libgles1 = "mesa"
PREFERRED_PROVIDER_virtual/libgles2 = "mesa"
PREFERRED_PROVIDER_virtual/egl = "mesa"

# Enable VC4 graphics driver
ENABLE_DWC2_HOST = "1"
ENABLE_UART = "1"
GPU_MEM = "128"

# Enable systemd
DISTRO_FEATURES:append = " systemd"
VIRTUAL-RUNTIME_init_manager = "systemd"
VIRTUAL-RUNTIME_initscripts = "systemd-compat-units"
# Optional: Remove sysvinit if you want pure systemd
DISTRO_FEATURES_BACKFILL_CONSIDERED:append = " sysvinit"

PACKAGECONFIG:append:pn-sdl3 = " wayland"
```

## conf/distro/simple-desktop.conf
```bitbake
require conf/distro/poky.conf

DISTRO = "simple-desktop"
DISTRO_NAME = "Simple Desktop"

EXTRA_IMAGE_FEATURES:remove = " debug-tweaks"
EXTRA_IMAGE_FEATURES:append = " allow-root-login"

ROOT_PASSWD = "\$6\$EcrQCmc4FC8oY8Gu\$MNtBPD8mOktVleWl.J69hFza.KfW2v4VBH7hMzgDATYCQJpBI1YWlFxoBeL.IqwkcSqGYMAojDzFPsh9GJJC4/"

INHERIT += "extrausers"
EXTRA_USERS_PARAMS = "usermod -p '${ROOT_PASSWD}' root;"

DISTRO_FEATURES:append = " wayland pam usrmerge"
PREFERRED_PROVIDER_virtual/mesa = "mesa"
PREFERRED_PROVIDER_virtual/libgl = "mesa"
PREFERRED_PROVIDER_virtual/libgles1 = "mesa"
PREFERRED_PROVIDER_virtual/libgles2 = "mesa"
PREFERRED_PROVIDER_virtual/egl = "mesa"

# Enable VC4 graphics driver
ENABLE_DWC2_HOST = "1"
ENABLE_UART = "1"
GPU_MEM = "128"

# Enable systemd
DISTRO_FEATURES:append = " systemd"
VIRTUAL-RUNTIME_init_manager = "systemd"
VIRTUAL-RUNTIME_initscripts = "systemd-compat-units"
# Optional: Remove sysvinit if you want pure systemd
DISTRO_FEATURES_BACKFILL_CONSIDERED:append = " sysvinit"

IMAGE_INSTALL:append = " \
    virtual-keyboard \
    evtest \
    libsdl3 \
    uart-text-viewer \
    "

PACKAGECONFIG:append:pn-sdl3 = " wayland"


# RPI_EXTRA_CONFIG = "dtoverlay=uart-echo-overlay"
# KERNEL_DEVICETREE:append = " overlays/uart-echo-overlay.dtbo"
# IMAGE_INSTALL:append = " uart-echo-overlay"

# IMAGE_INSTALL:append = " my-dtbo"


# RPI_KERNEL_DEVICETREE_OVERLAYS += "overlays/uart-echo-overlay.dtbo"



# IMAGE_INSTALL:append = " my-boot-files"

# RPI_KERNEL_DEVICETREE_OVERLAYS += "overlays/very-special-file.dtbo "
```

## conf/distro/simple-framebuffer.conf
```bitbake
require conf/distro/poky.conf

DISTRO = "simple-framebuffer"
DISTRO_NAME = "Simple framebuffer distro"

EXTRA_IMAGE_FEATURES:remove = " debug-tweaks"
EXTRA_IMAGE_FEATURES:append = " allow-root-login"

ROOT_PASSWD = "\$6\$EcrQCmc4FC8oY8Gu\$MNtBPD8mOktVleWl.J69hFza.KfW2v4VBH7hMzgDATYCQJpBI1YWlFxoBeL.IqwkcSqGYMAojDzFPsh9GJJC4/"

INHERIT += "extrausers"
EXTRA_USERS_PARAMS = "usermod -p '${ROOT_PASSWD}' root;"

# Import common HDMI config
require conf/distro/common-hdmi.inc
```

## layers/meta-mylayer/conf/distro/distro-eglfs.conf
```bitbake
require conf/distro/poky.conf

DISTRO = "distro-eglfs"
DISTRO_NAME = "eglfs distro"

INHERIT += "extrausers"
RAW_PASSWORD = "pi"
PASSWD_ROOT="$(printf '${RAW_PASSWORD}' | openssl passwd -6 -stdin)"
EXTRA_USERS_PARAMS = " usermod -p '${PASSWD_ROOT}' root; "

DISTRO_FEATURES:remove = "x11 wayland"
DISTRO_FEATURES:append = " opengl kms drm udev eglkms pam"
VIRTUAL-RUNTIME_dev_manager = "udev"

INIT_MANAGER = "sysvinit"

MACHINE_FEATURES:append = " vc4graphics"
GPU_MEM = "128"
CMDLINE:append = " video=HDMI-A-1:1920x1080M@60D"

ENABLE_UART = "1"

PREFERRED_VERSION_linux-raspberrypi = "6.12.%"
IMAGE_INSTALL:append = " kernel-modules raspi-utils"


IMAGE_INSTALL:append = " virtual-keyboard"
IMAGE_INSTALL:append = " devicetree-overlay"
RPI_EXTRA_CONFIG = "\ndtoverlay=devicetree-overlay"
IMAGE_BOOT_FILES:append = " overlays/devicetree-overlay.dtbo"
```

## meta-mylayer/wic/mywic.wks
```
part /boot --source bootimg-partition --ondisk mmcblk0 --fstype=vfat --label boot --active --align 4096 --size 100
part --source rootfs --ondisk mmcblk0 --label rootfsA --fstype=ext4 --size=1024M --align 4096
part --source rootfs --ondisk mmcblk0 --label rootfsB --fstype=ext4 --size=1024M --align 4096
```
